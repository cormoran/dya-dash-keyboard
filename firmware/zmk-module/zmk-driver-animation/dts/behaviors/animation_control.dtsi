/*
 * Copyright (c) 2020 The ZMK Contributors
 *
 * SPDX-License-Identifier: MIT
 */

/ {
    behaviors {
        /omit-if-no-ref/ animctl: animctl {
            compatible = "zmk,behavior-animation-control";
            #binding-cells = <2>;
            display-name = "Animation control";
        };
    };
};
