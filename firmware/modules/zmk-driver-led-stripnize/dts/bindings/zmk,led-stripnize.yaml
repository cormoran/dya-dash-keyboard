## firmware/modules/zmk-driver-led-stripnize/dts/bindings/zmk,led-stripnize.yaml
```yaml
# Copyright (c) 2025 cormoran
# SPDX-License-Identifier: MIT

description: |
  AA
compatible: "zmk,led-stripnize"
properties:
  led:
    type: phandle
    required: true
  red-index:
    type: int
    default: 0
  green-index:
    type: int
    default: 1
  blue-index:
    type: int
    default: 2
  chain-length:
    type: int
    default: 1
```

## firmware/zmk-module/west.yml
```yaml
manifest:
  remotes: []
  projects:
    # - name: zmk
    #   remote: cormoran
    #   revision: main
    #   import: app/west.yml
    - name: zmk-pmw3610-driver
      path: firmware/zmk-module/zmk-pmw3610-driver
      url: .
      # revision: test
      import: true
      # remote: cormoran
      # revision: main
    - name: zmk-feature-default-layer
      path: firmware/zmk-module/zmk-feature-default-layer
      url: .
      import: true
      # remote: cormoran
      # revision: main
    - name: zmk-driver-animation
      path: firmware/zmk-module/zmk-driver-animation
      url: .
      import: true
      # remote: cormoran
      # revision: main
    - name: zmk-driver-ext-power-transient
      path: firmware/zmk-module/zmk-driver-ext-power-transient
      url: .
      import: true
      # remote: cormoran
      # revision: main
    - name: zmk-driver-led-stripnize
      path: firmware/zmk-module/zmk-driver-led-stripnize
      url: .
      import: true
      # remote: cormoran
      # revision: main
    - name: zmk-keyboard-dya-dash
      path: firmware/zmk-module/zmk-keyboard-dya-dash
      url: .
      import: true
  self:
    path: firmware/zmk-module
```

## firmware/zmk-module/zmk-driver-animation/Kconfig
```kconfig
config ZMK_ANIMATION
    bool "RGB Animations"
    select LED_STRIP

if ZMK_ANIMATION

config ZMK_ANIMATION_FPS
    int "Animation FPS"
    range 1 60
    default 30

config ZMK_ANIMATION_STOP_ON_IDLE
    bool "Whether to stop animation on idle state or not"
    default y

config ZMK_ANIMATION_PIXEL_DISTANCE
    bool "Generate a lookup table for distances between pixels"
    default y

config ZMK_ANIMATION_TRIGGER_MAX_PARALELISM
    int "Maximum parallelism for animation trigger"
    default 10

config ZMK_ANIMATION_TRIGGER_MAX_DURATION_MS
    int "Maximum animation play duration for animation trigger"
    default 10000

config ZMK_ANIMATION_TRIGGER_MIN_DURATION_MS
    int "Minimum animation play duration for animation trigger"
    default 1000

config ZMK_ANIMATION_TRIGGER_EXTEND_MS_ON_HOLD
    int "Animation play duration extension on hold"
    default 500

#ZMK_ANIMATION
endif
```

## firmware/zmk-module/zmk-driver-animation/dts/bindings/animations/zmk,animation-battery-status.yaml
```yaml
# Copyright (c) 2020, The ZMK Contributors
# SPDX-License-Identifier: MIT

description: |
  Animation for displaying battery status
compatible: "zmk,animation-battery-status"
include: animation_base.yaml

properties:
  animation-duration-seconds:
    type: int
    default: 1
    description: |
      blink animation cycle duration in seconds.
  color-high:
    type: int
    required: true
  color-middle:
    type: int
    required: true
  color-low:
    type: int
    required: true
  low-alert-start-threshold:
    type: int
    default: 10
    description: |
      battery level percentage threshold to start low battery alert to prompt battery charge
  low-alert-stop-threshold:
    type: int
    default: 5
    description: |
      battery level percentage threshold to stop low battery alert to avoid consuming battery by the alert
  low-alert-interval-seconds:
    type: int
    default: 60
  low-alert-duration-ms:
    type: int
    default: 10
    description: |
      Low alert animation duration in milliseconds to stop.
```

## firmware/zmk-module/zmk-driver-animation/dts/bindings/animations/zmk,animation-compose.yaml
```yaml
# Copyright (c) 2025, cormoran
# SPDX-License-Identifier: MIT

description: |
  Animation driver which enables to play multiple animations sequentially or in parallel.

compatible: "zmk,animation-compose"

properties:
  animations:
    type: phandles
    required: true

  durations-ms:
    type: array
    required: true
    description: |
      Duration of each animation in milliseconds.

  parallel:
    type: boolean
    description: |
      If true, all animations are played in parallel.
      If false, all animations are played sequentially.
```

## firmware/zmk-module/zmk-driver-animation/dts/bindings/animations/zmk,animation-control.yaml
```yaml
# Copyright (c) 2020, The ZMK Contributors
# Copyright (c) 2025, cormoran
# SPDX-License-Identifier: MIT

description: |
  Higher-order animation which allows for controlling animation drivers
  placed underneath it by turning them on and off, cycling though them,
  or changing the brightness.

compatible: "zmk,animation-control"

properties:
  label:
    type: string
    required: true

  powered-animations:
    type: phandles
    required: true
    description: |
      Animations played under USB bus power

  battery-animations:
    type: phandles
    required: true
    description: |
      Animations played under battery power

  behavior-animations:
    type: phandles
    required: true
    description: |
      Animations playable from behavior

  init-animation:
    type: phandle
    description: |
      Animations played after initialization

  init-animation-duration-ms:
    type: int
    default: 0
    description: |
      Duration of the init animation in milliseconds.
      Setting to 0 plays init-animation until it finishes.

  init-animation-delay-ms:
    type: int
    default: 100
    description: |
      Delay before starting the init animation in milliseconds after startup.

  activation-animation:
    type: phandle
    description: |
      Animations played after activation (resume from sleep)

  activation-animation-duration-ms:
    type: int
    default: 0
    description: |
      Duration of the activation animation in milliseconds.
      Setting to 0 plays activation-animation until it finishes.

  ext-power:
    type: phandle
    description: |
      Power for the led stripe device.
      The power is disabled when no animation selected or idle/sleep mode

  brightness-steps:
    type: int
    default: 10
    description: |
      How many brightness steps should be supported.

  max-brightness:
    type: int
    default: 128
    description: |
      Max RGB color value. 0 to 255

  queue-size:
    type: int
    default: 16
    description: |
      Size of the message queue for the animation control driver.
      This is used to store messages sent to the animation control driver.
      The size of the queue should be large enough to hold all messages
      sent to the animation control driver.
```

## firmware/zmk-module/zmk-driver-animation/dts/bindings/animations/zmk,animation-empty.yaml
```yaml
# Copyright (c) 2025 cormoran
# SPDX-License-Identifier: MIT

description: |
  Dummy device to stop animation
compatible: "zmk,animation-empty"
```

## firmware/zmk-module/zmk-driver-animation/dts/bindings/animations/zmk,animation-endpoint.yaml
```yaml
# Copyright (c) 2020, The ZMK Contributors
# SPDX-License-Identifier: MIT

description: |
  Animation for displaying endpoint status (BLE connection status & USB)
compatible: "zmk,animation-endpoint"
include: animation_base.yaml

properties:
  duration-seconds-on-endpoint-change:
    type: int
    default: 1
    description: |
      Animation duration in seconds for endpoint change.
      Duration is extended to not-connected-duration-seconds if current BLE profile is not connected.
      Setting this to 0 disables playing animation on endpoint change.
  not-connected-duration-seconds:
    type: int
    default: 5
    description: |
      Animation duration in seconds for not-connected-status.
      Duration is extended to this value if current BLE profile is not connected.
  blink-duration-seconds:
    type: int
    default: 1
    description: |
      Duration in seconds for blink cycle in animation.
  extend-duration-seconds:
    type: int
    default: 2
    description: |
      Duration to extend if BLE profile status changed during playing the animation.
  event-handling-start-seconds:
    type: int
    default: 2
    description: |
      Duration seconds from system startup.
      Events during this duration is ignored.
  color-open:
    type: int
    required: true
  color-connected:
    type: int
    required: true
  color-disconnected:
    type: int
    required: true
  color-usb:
    type: int
    required: true
```

## firmware/zmk-module/zmk-driver-animation/dts/bindings/animations/zmk,animation-layer-status.yaml
```yaml
# Copyright (c) 2020, The ZMK Contributors
# SPDX-License-Identifier: MIT

description: |
  Animation for active layer status.
  pixels[i] brights when layer[i] is enabled.

compatible: "zmk,animation-layer-status"
include: animation_base.yaml

properties:
  default-color:
    type: int
  colors:
    type: array
    description: |
      List of colors for each layer.
      Default color is used if 0 is specified or the length is smaller than layer count.
  layer-offset:
    type: int
    default: 0
    description: |
      If the value is specified, layer i is mapped to pixels[i - layer-offset].
      It enables to use all LEDs in split keyboard to indicate active layer.
  extend-duration-seconds:
    type: int
    default: 2
    description: |
      Duration to extend if BLE profile status changed during playing the animation.
```

## firmware/zmk-module/zmk-driver-animation/dts/bindings/animations/zmk,animation-queue.yaml
```yaml
# Copyright (c) 2020, The ZMK Contributors
# SPDX-License-Identifier: MIT

description: Queue

compatible: "zmk,animation-queue"

properties:
  que-size:
    type: int
    default: 16
    description: |
      Size of the message queue for the animation control driver.
      This is used to store messages sent to the animation control driver.
      The size of the queue should be large enough to hold all messages
```

## firmware/zmk-module/zmk-driver-animation/dts/bindings/behaviors/zmk,behavior-animation-control.yaml
```yaml
# Copyright (c) 2020 The ZMK Contributors
# SPDX-License-Identifier: MIT

description: Animation Control

compatible: "zmk,behavior-animation-control"

include: two_param.yaml
```

## firmware/zmk-module/zmk-driver-animation/dts/bindings/behaviors/zmk,behavior-animation-layer-status.yaml
```yaml
# Copyright (c) 2025 cormoran
# SPDX-License-Identifier: MIT

description: Behavior to play animation

compatible: "zmk,behavior-animation-layer-status"

include: two_param.yaml
```

## firmware/zmk-module/zmk-driver-animation/dts/bindings/behaviors/zmk,behavior-animation-trigger.yaml
```yaml
# Copyright (c) 2025 cormoran
# SPDX-License-Identifier: MIT

description: Behavior to play animation

compatible: "zmk,behavior-animation-trigger"

include: two_param.yaml
```

## firmware/zmk-module/zmk-driver-ext-power-transient/dts/bindings/zmk,ext-power-transient.yaml
```yaml
# Copyright (c) 2025 cormoran
# SPDX-License-Identifier: MIT

description: |
  Simple ext-power driver implementation without persistent storage.
  Intended to be used for switching power supply friquently to save power.
compatible: "zmk,ext-power-transient"
properties:
  control-gpios:
    type: phandle-array
    required: true
```

## firmware/zmk-module/zmk-keyboard-dya-dash/boards/shields/dya_dash/Kconfig.defconfig
```kconfig
if SHIELD_DYA_DASH_RIGHT

config ZMK_KEYBOARD_NAME
    default "Dya Dash KB"

config ZMK_SPLIT_ROLE_CENTRAL
    default y

config PMW3610
    default y
config ZMK_POINTING
    default y

config ZMK_SPLIT_BLE_CENTRAL_BATTERY_LEVEL_PROXY
    default y
config ZMK_SPLIT_BLE_CENTRAL_BATTERY_LEVEL_FETCHING
    default y
# config ZMK_STUDIO
#     default y
config ZMK_DEFAULT_LAYER_MIN_INDEX
    int "min layer index configurable as default layer"
    default 0

config ZMK_DEFAULT_LAYER_MAX_INDEX
    int "max layer index configurable as default layer"
    default 4
endif

if SHIELD_DYA_DASH_LEFT || SHIELD_DYA_DASH_RIGHT

config ZMK_SPLIT
    default y
config ZMK_BATTERY_REPORTING
    default y
config LED_STRIP
    default y
config SPI
    default y
config ZMK_SLEEP
    default y
config ZMK_PM_SOFT_OFF
    default y
config ZMK_DEFAULT_LAYER
    default y
config ZMK_DRIVER_EXT_POWER_TRANSIENT
    default y
config ZMK_SETTINGS_SAVE_DEBOUNCE
    default 10000

endif
```

## firmware/zmk-module/zmk-keyboard-dya-dash/boards/shields/dya_dash/Kconfig.shield
```kconfig
config SHIELD_DYA_DASH_LEFT
   def_bool $(shields_list_contains,dya_dash_left)

config SHIELD_DYA_DASH_RIGHT
   def_bool $(shields_list_contains,dya_dash_right)
```

## firmware/zmk-module/zmk-keyboard-dya-dash/config/west.yml
```yaml
manifest:
  remotes:
    - name: zmkfirmware
      url-base: https://github.com/zmkfirmware
    - name: cormoran
      url-base: https://github.com/cormoran
    - name: caksoylar
      url-base: https://github.com/caksoylar
  projects:
    - name: zmk
      remote: cormoran
      revision: main
      import: app/west.yml
    - name: zmk-pmw3610-driver
      remote: cormoran
      revision: main
    - name: zmk-feature-default-layer
      remote: cormoran
      revision: main
  self:
    path: config
```
